## boards/arm/bault/Kconfig
```kconfig
# Copyright (c) 2024 Brandon Beltran
# SPDX-License-Identifier: MIT

config BOARD_ENABLE_DCDC
    bool "Enable DCDC mode"
    select SOC_DCDC_NRF52X
    default y
    depends on BOARD_BAULT
```

## boards/arm/bault/Kconfig.board
```kconfig
# Copyright (c) 2024 Brandon Beltran
# SPDX-License-Identifier: MIT

config BOARD_BAULT
    bool "bault"
    depends on SOC_NRF52840_QIAA
```

## boards/arm/bault/Kconfig.defconfig
```kconfig
# Copyright (c) 2024 Brandon Beltran
# SPDX-License-Identifier: MIT

if BOARD_BAULT

config ZMK_KEYBOARD_NAME
    default "BaulT"

config BT_CTLR
    default BT

endif # BOARD_BAULT
```

## boards/config/west.yml
```yaml
manifest:
  remotes:
    - name: zmkfirmware
      url-base: https://github.com/zmkfirmware
    # Add the base GitHub URL as a remote.
    - name: armastardo # You can name this whatever you like; just make sure the "remote" below matches.
      url-base: https://github.com/Armastardo
  projects:
    - name: zmk
      remote: zmkfirmware
      revision: main
      import: app/west.yml
    # Add the name of the repository as a project.
    - name: bault-zmk-config
      remote: armastardo
      revision: main # This is the name of the branch you want to use.
  self:
    path: config
```
